## meta-firealarm/conf/distro/firealarm.conf
```bitbake
include meta-poky/conf/distro/poky.conf

# DISTRO = "firealarm"
# DISTRO_NAME = "FireAlarm"
# DISTRO_VERSION = "4.0.20"
# DISTRO_CODENAME = "kirkstone"

# CONF_VERSION = "2"

# DISTRO_FEATURES += " systemd pulseaudio x11 audio-only "
# VIRTUAL-RUNTIME_init_manager = "systemd"
# VIRTUAL-RUNTIME_initscripts = ""
# INIT_MANGER = "systemd"

# VIRTUAL-RUNTIME_initscripts = "systemd-compat-units"
# VIRTUAL-RUNTIME_login_manager = "shadow-base"
# VIRTUAL-RUNTIME_dev_manager = "systemd"

# IMAGE_INSTALL_append = " kernel-modules"
# IMAGE_INSTALL_append = " spi-tools"
# IMAGE_INSTALL_append = " python3-smbus"

# PREFERRED_PROVIDER_virtual/java-initial-native = "cacao-initial-native"
# PREFERRED_PROVIDER_virtual/java-native = "cacao-native"
# LICENSE_FLAGS_ACCEPTED = "commercial"

# PREFERRED_PROVIDER_virtual/javac-native = "ecj-bootstrap-native"

# IMAGE_INSTALL:append = " openjdk-8 pulseaudio speexdsp"
# IMAGE_INSTALL:append = " dropbear systemd systemd-serialgetty ledmod "
# IMAGE_INSTALL:append = " gstreamer1.0-plugins-good gstreamer1.0-plugins-base gstreamer1.0-plugins-ugly alsa-utils alsa-lib "
# LICENSE_FLAGS_ACCEPTED:append = " commercial commercial_gstreamer1.0-plugins-ugly"
# PACKAGECONFIG:pn-qtmultimedia = " gstreamer alsa"

# KERNEL_MODULE_AUTOLOAD:rpi = "snd-bcm2835"
# MACHINE_FEATURES:append = "sound"

# IMAGE_FSTYPES = "tar.xz ext3 rpi-sdimg"
# INHERIT = "rm_work"
# ENABLE_UART = "1"
# ENABLE_SPI  = "1"

# MAINTAINER = "elgaarxyz@gmail.com"
# PREFERRED_VERSION_linux-yocto = "5.15%"

DISTRO = "firealarm"
DISTRO_NAME = "FireAlarm"
DISTRO_VERSION = "4.0.20"
DISTRO_CODENAME = "kirkstone"

CONF_VERSION = "2"

DISTRO_FEATURES += " systemd pulseaudio x11 audio-only "
VIRTUAL-RUNTIME_init_manager = "systemd"
VIRTUAL-RUNTIME_initscripts = "systemd-compat-units"
VIRTUAL-RUNTIME_login_manager = "shadow-base"
VIRTUAL-RUNTIME_dev_manager = "systemd"

#PREFERRED_PROVIDER_virtual/java-initial-native = "cacao-initial-native"
#PREFERRED_PROVIDER_virtual/java-native = "cacao-native"
#LICENSE_FLAGS_ACCEPTED = "commercial"

PREFERRED_PROVIDER_virtual/javac-native = "ecj-bootstrap-native"

IMAGE_INSTALL:append = " packagegroup-core-buildessential "




MACHINE_FEATURES:append = " spi"
IMAGE_INSTALL:append = " spidev-tools"
IMAGE_INSTALL:append = " kernel-modules"
IMAGE_INSTALL:append = " python3-smbus"
TOOLCHAIN_TARGET_TASK:append = " gcc g++"

IMAGE_INSTALL:append = " pulseaudio speexdsp"
IMAGE_INSTALL:append = "  systemd systemd-serialgetty"
IMAGE_INSTALL:append = " gstreamer1.0-plugins-good gstreamer1.0-plugins-base gstreamer1.0-plugins-ugly alsa-utils alsa-lib "
LICENSE_FLAGS_ACCEPTED:append = " commercial commercial_gstreamer1.0-plugins-ugly"
PACKAGECONFIG:pn-qtmultimedia = " gstreamer alsa"

KERNEL_MODULE_AUTOLOAD:rpi = "snd-bcm2835"
MACHINE_FEATURES:append = "sound"

IMAGE_INSTALL:append = " pavucontrol pulseaudio pulseaudio-module-dbus-protocol pulseaudio-module-loopback pulseaudio-server  alsa-utils alsa-plugins packagegroup-rpi-test"

PREFERRED_VERSION_python3 = "3.10.14"
PREFERRED_VERSION_python3-dev = "3.10.14"
PREFERRED_PROVIDER_virtual/kernel = "linux-raspberrypi"


# PN_INSTALL+="jdk17"
# FILES_jdk17 += "/home/mohamed/Desktop/Yocto/poky/build/tmp-glibc/work/cortexa72-oe-linux/jdk17/0.1-r0/deploy-rpms/cortexa72"

PREFERRED_VERSION_linux-raspberrypi = "6.1.77%"

IMAGE_INSTALL:append = " python3 python3-pip python3-dev \
  kernel-modules libxkbui \
  python3-spidev canutils i2c-tools spi-tools\
  make gcc dpkg apt"

MAGE_INSTALL:append = " \
    python3 \
    util-linux \
    bluez5 \
    i2c-tools \
    bridge-utils \
    hostapd \
    iptables \
    wpa-supplicant \
    pi-bluetooth \
    bluez5-testtools \
    udev-rules-rpi \
    linux-firmware \
    iw \
    kernel-modules \
    linux-firmware-ralink \
    linux-firmware-rtl8192ce \
    linux-firmware-rtl8192cu \
    linux-firmware-rtl8192su \
    linux-firmware-rpidistro-bcm43430 \
    linux-firmware-bcm43430 \
    connman \
    connman-client \
    dhcpcd \
    openssh \
    psplash \
    psplash-raspberrypi \
    coreutils \
"

DISTRO_FEATURES:append = " \
    bluez5 \
    bluetooth \
    wifi \
    pi-bluetooth \
    linux-firmware-bcm43430 \
    systemd \
    usrmerge \
    ipv4 \
"

MACHINE_FEATURES:append = " \
    bluetooth \
    wifi \
"

IMAGE_FEATURES:append = " \
    splash \
"
IMAGE_INSTALL:append = " xserver-xorg xf86-video-fbdev xf86-input-evdev xterm matchbox-wm"





MAGE_INSTALL:append = " device-tree-overlays"



IMAGE_INSTALL:append = " setserial"


IMAGE_FSTYPES = "tar.xz ext3 rpi-sdimg"
INHERIT = "rm_work"
ENABLE_UART = "1"
ENABLE_SPI  = "1"

MAINTAINER = "mohamedsamirahmed23@gmail.com"
```

## meta-firealarm/conf/layer.conf
```bitbake
# We have a conf and classes directory, add to BBPATH
BBPATH .= ":${LAYERDIR}"

# We have recipes-* directories, add to BBFILES
BBFILES += "${LAYERDIR}/recipes-*/*/*.bb \
            ${LAYERDIR}/recipes-*/*/*.bbappend"

BBFILE_COLLECTIONS += "meta-firealarm"
BBFILE_PATTERN_meta-firealarm = "^${LAYERDIR}/"
BBFILE_PRIORITY_meta-firealarm = "6"

LAYERDEPENDS_meta-firealarm = "core"
LAYERSERIES_COMPAT_meta-firealarm = "kirkstone"
```
